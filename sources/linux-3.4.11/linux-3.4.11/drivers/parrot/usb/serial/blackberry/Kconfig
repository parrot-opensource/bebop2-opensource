## sources/linux-unknown/linux-unknown/drivers/parrot/mfd/Kconfig
```kconfig
config MFD_HAVE_P7MU
	bool
	depends on MFD_P7MU && I2C
	select MFD_CORE
	select IRQ_DOMAIN
	default y
	help
	 Support for the Parrot Power Management Unit companion chip.
	 This driver provies common support for accessing the device,
	 additional drivers must be enabled in order to use the functionality
	 of the device

config MFD_P7MU
	bool "Parrot Power Management Unit (PMU) companion chip core support"

config MFD_P7MU_DEBUG
	bool "Debug Parrot PMU"
	depends on MFD_P7MU
	default no
	help
	 Build Parrot PMU support with debug enabled

config SICILIA_IRRADIANCE
	tristate "Sicilia irradiance module"
	depends on MFD_DIB0700 && LEDS_PCA9633 && LEDS_NCP5623C && TSL2591
	default no
	help
	 Support for the Parrot Sicilia irradiance module

config MFD_DIB0700
	tristate "DiB700 I2C/UART/GPIO"
	help
	 Driver for multi-function devices based on DiBcom DiB0700 - USB bridge
```

## sources/linux-unknown/linux-unknown/drivers/parrot/mmc/Kconfig
```kconfig
config MMC_SDHCI_ACS3
   tristate "Arasan SD3.0 / SDIO3.0 / eMMC4.41 driver"
   depends on MMC && MMC_SDHCI
   select MMC_SDHCI_IO_ACCESSORS
   default MMC_SDHCI if ARCH_PARROT7
   help
     Support Arasan Chip Systems SD3.0 / SDIO3.0 / eMMC4.41 AHB Host Controller driver.

config MMC_SDHCI_ACS3_DEBUGFS
	bool "ACS3 TDLs & max clk debugfs"
	depends on MMC_SDHCI_ACS3
	default n
	
```

## sources/linux-unknown/linux-unknown/drivers/parrot/pinctrl/Kconfig
```kconfig
config PINCTRL_PARROT7
	bool
	depends on ARCH_PARROT7
	select PINCTRL
	select PINMUX
	select PINCONF
	default y
```

## sources/linux-unknown/linux-unknown/drivers/parrot/power/Kconfig
```kconfig
config FAKE_BATTERY
	bool "Fake Android Battery Driver"
	depends on POWER_SUPPLY
	help
	  Fake battery driver for Android battery service
```

## sources/linux-unknown/linux-unknown/drivers/parrot/rtc/Kconfig
```kconfig
config RTC_P7MU
	tristate "Parrot P7MU RTC"
	depends on RTC_CLASS && MFD_P7MU
	default MFD_P7MU
	help
	  If you say yes here you get support for RTC function Parrot
	  Power Management Unit companion chip.

	  This driver can also be built as a module. If so, the module
	  will be called rtc-pxmu.
```

## sources/linux-unknown/linux-unknown/drivers/parrot/sound/p7_aai/Kconfig
```kconfig
config SND_AAI
	tristate "Parrot7 AAI"
		depends on SND
		depends on ARCH_PARROT7 || ARCH_VEXPRESS
		select SND_PCM
		select SND_HWDEP
		select SND_DYNAMIC_MINORS
		help
			Parrot7 AAI driver.
			This is specific to Parrot7 architecture.

config SND_AAI_DEBUG
	bool  "AAI Debug Mode"
		default 0
		depends on SND_AAI
		help
			Activate AAI debug level messages.
			Trace AAI registers read/write operations.
```

## sources/linux-unknown/linux-unknown/drivers/parrot/uio/Kconfig
```kconfig
config UIO_HX
	tristate "On2 / Hantro video userspace driver support"
    default m if ARCH_PARROT7
	default no if !ARCH_PARROT7
	help
	  Enable support for On2 / Hantro video userspace drivers.

config UIO_HX_DEBUG
    bool "Enable debug for On2 / Hantro video userspace driver"
    depends on UIO_HX
    default no
	help
	  Compile On2 / Hantro video userspace drivers with debug enabled.

config UIO_HX270
	tristate "On2 / Hantro hx270 video decoder support"
	depends on UIO_HX
    default UIO_HX
	help
      Enable support for On2 / Hantro video decoder.

config UIO_HX280
	tristate "On2 / Hantro hx280 video encoder support"
	depends on UIO_HX
    default UIO_HX
	help
      Enable support for On2 / Hantro video encoder.
```
