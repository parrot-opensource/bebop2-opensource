## sources/linux-3.4.11/linux-3.4.11/drivers/parrot/usb/serial/blackberry/Kconfig
```kconfig
config BLACKBERRY
	tristate "Blackberry usb serial driver"
	depends on USB_SERIAL
	-- help
	Driver which provides access to a blackberry via it's proprietary usb
	interface using ttys
```

## sources/linux-3.4.11/linux-3.4.11/drivers/staging/ulogger/Kconfig
```kconfig
config ULOGGER
	boolean "Ulogger, a fork of Android Logger with a few additional features"
	default n

if ULOGGER
config ULOGGER_BUF_SHIFT
	int "Ulogger static log buffer size (17 => 128KB, 18 => 256KB)"
	range 16 20
	default 18
	help
	  Select ulogger static log (ulog_main) buffer size as a power of 2.
	  Examples:
		     18 => 256 KB
		     17 => 128 KB
		     16 => 64 KB
	             15 => 32 KB

config ULOGGER_USE_MONOTONIC_CLOCK
	bool "Use raw monotonic clock"
	default n
	help
	  Use raw monotonic clock (CLOCK_MONOTONIC_RAW) for timestamps instead
	  of kernel wallclock. Note that this clock may differ from the one used
	  in printk messages.

endif # ULOGGER
```

## sources/linux-3.4.11/linux-3.4.11/sound/soc/parrot/Kconfig
```kconfig
config SND_SOC_PARROT_FC7100
	tristate "Support for the Parrot FC7100 board"
	depends on I2C && MACH_PARROT_FC7100_FAMILY
	select SND_SOC_WAU8822
	select SND_SOC_WM8594
	select SND_SOC_ADAU1977
	help
	  Say Y if you want to add support for the Parrot FC7100
	  board.
```

## sources/linux-unknown/linux-unknown/arch/arm/mach-vexpress/Kconfig
```kconfig
menu "Versatile Express platform type"
	depends on ARCH_VEXPRESS

config ARCH_VEXPRESS_CORTEX_A5_A9_ERRATA
	bool
	select ARM_ERRATA_720789
	select ARM_ERRATA_751472
	select PL310_ERRATA_753970 if CACHE_PL310
	help
	  Provides common dependencies for Versatile Express platforms
	  based on Cortex-A5 and Cortex-A9 processors. In order to
	  build a working kernel, you must also enable relevant core
	  tile support or Flattened Device Tree based support options.

config ARCH_VEXPRESS_CA9X4
	bool "Versatile Express Cortex-A9x4 tile"
	select ARCH_VEXPRESS_CORTEX_A5_A9_ERRATA
	select ARM_GIC
	select CPU_V7
	select HAVE_SMP
	select MIGHT_HAVE_CACHE_L2X0

config ARCH_VEXPRESS_DT
	bool "Device Tree support for Versatile Express platforms"
	select ARCH_VEXPRESS_CORTEX_A5_A9_ERRATA
	select ARM_GIC
	select ARM_PATCH_PHYS_VIRT
	select AUTO_ZRELADDR
	select CPU_V7
	select HAVE_SMP
	select MIGHT_HAVE_CACHE_L2X0
	select USE_OF
	help
	  New Versatile Express platforms require Flattened Device Tree to
	  be passed to the kernel.

	  This option enables support for systems using Cortex processor based
	  ARM core and logic (FPGA) tiles on the Versatile Express motherboard,
	  for example:

	  - CoreTile Express A5x2 (V2P-CA5s)
	  - CoreTile Express A9x4 (V2P-CA9)
	  - CoreTile Express A15x2 (V2P-CA15)
	  - LogicTile Express 13MG (V2F-2XV6) with A5, A7, A9 or A15 SMMs
	    (Soft Macrocell Models)
	  - Versatile Express RTSMs (Models)

	  You must boot using a Flattened Device Tree in order to use these
	  platforms. The traditional (ATAGs) boot method is not usable on
	  these boards with this option.

	  If your bootloader supports Flattened Device Tree based booting,
	  say Y here.

config ARCH_VEXPRESS_P7FPGA
	bool "Versatile Express P7 FPGA tile"
	depends on ARCH_VEXPRESS
	default n
	help
	  Enable support for P7 firmware on FPGA tile.

config ARCH_VEXPRESS_ZBT_ENABLE
	bool "Enable ZBT RAM"
	depends on ARCH_VEXPRESS_P7FPGA
	default n
	help
	  Enable the ZBT RAM usage for framebuffer.

menuconfig ARCH_PARROT7_VEXPRESS_RNB6
	bool "RNB6 daughter board"
	depends on I2CM_PARROT7_LEGACY || I2CM_PARROT7 || ARCH_VEXPRESS
	default y
	help
	  Support for RNB6 daughter board connected to motherboard J100
	  connector. It contains: 
	  -one HDMI input,
	  -one HDMI output,
	  -one analog video input,
	  -one camera connectors,
	  -one LCD panel connector.

config ARCH_PARROT7_VEXPRESS_RNB6_LCD0_ENABLE
	bool "Enable LCD panel output on LCD0 (connector RNB6 J900)"
	depends on ARCH_PARROT7_VEXPRESS_RNB6
	default n
	help
	  Enable the LCD panel output and frame buffer associated (LCD0 on connector RNB6 J900).
      

config ARCH_PARROT7_VEXPRESS_RNB6_LCD1_ENABLE
	bool "Enable HDMI output (connector RNB6 J400)"
	depends on ARCH_PARROT7_VEXPRESS_RNB6
	default y
	help
	  Enable the HDMI output (connector RNB6 J400) and frame buffer associated.

config ARCH_PARROT7_VEXPRESS_RNB6_CAMERA_ENABLE
    bool "Enable Camera input (CAM1 on connector RNB6 J800/J801)"
    depends on ARCH_PARROT7_VEXPRESS_RNB6
    default y
    help
      Enable the camera input on CAM1 (connectors RNB6 J800/J801).
      
config ARCH_PARROT7_VEXPRESS_RNB6_CAM_1_HS_VS
    bool "CAM1: HS/VS are wired"
    depends on ARCH_PARROT7_VEXPRESS_RNB6_CAMERA_ENABLE
    default y
    help
      If the R9 and R10 0 ohm resistors are soldered on the RNB6 board,
      the HS and VS signals of the CAM 1 are wired and we can no longer
      use LCD_0_DEN and LCD_0_HS (they're muxed on the same PINS). That
      means we can no longer use LCD 0 (unless we have a screen that
      understands ITU BT656 and this option has been enabled for LCD0).
      
config ARCH_PARROT7_VEXPRESS_RNB6_CAM_1_BT656
    bool "CAM1: Use ITU BT656 embedded synchronization"
    depends on ARCH_PARROT7_VEXPRESS_RNB6_CAMERA_ENABLE
    default n
    help
      The CAM1 capture module uses embedded synchronization signals as defined in ITU BT656.

choice 
    prompt "CAM1: Type of camera" 
    depends on ARCH_PARROT7_VEXPRESS_RNB6_CAMERA_ENABLE
    default ARCH_PARROT7_VEXPRESS_RNB6_CAM_1_SOC_TYPE_AS0260
    help
      Type of camera on CAM1.

    config ARCH_PARROT7_VEXPRESS_RNB6_CAM_1_SOC_TYPE_MT9V117
        bool "SoC camera MT9V117 (VGA 640x480)"
        help 
          Select a camera MT9V117 (VGA 640x480)(cresyn) for CAM1

    config ARCH_PARROT7_VEXPRESS_RNB6_CAM_1_SOC_TYPE_MT9M114
        bool "SoC camera MT9M114 (HD 1280x720)"
        help 
          Select a camera MT9M114 (HD 1280x720) for CAM1

    config ARCH_PARROT7_VEXPRESS_RNB6_CAM_1_SOC_TYPE_AS0260
        bool "SoC camera AS0260 (Full HD 1920x1080)"
        help 
          Select a camera AS0260 (Full HD 1920x1080) for CAM1
          
    config ARCH_PARROT7_VEXPRESS_RNB6_CAM_1_SOC_TYPE_MT9F002
        bool "SoC camera MT9F002 (14 Mpixels)"
        help 
          Select a camera MT9F002 (14 Mpixels) for CAM1

endchoice

endmenu
```

## sources/linux-unknown/linux-unknown/drivers/media/video/ov16825/Kconfig
```kconfig
config VIDEO_OV16825
	tristate "OmniVision OV16825 sensor support"
	depends on I2C && VIDEO_V4L2
	---help---
	  Video4Linux2 sensor-level driver for the OmniVision
	  OV16825 camera.
```

## sources/linux-unknown/linux-unknown/drivers/parrot/cpufreq/Kconfig
```kconfig
config ARM_P7_CPUFREQ
	bool "P7 CPU Frequency scaling support"
	depends on ARCH_PARROT7
	select CPU_FREQ
```

## sources/linux-unknown/linux-unknown/drivers/parrot/crypto/Kconfig
```kconfig
config CRYPTO_DEV_P7
	tristate "Support for P7 crypto hw accelerator"
	depends on NET
	select CRYPTO_BLKCIPHER
	select CRYPTO_USER_API_HASH
	select CRYPTO_USER_API_SKCIPHER
	help
	  P7 processors have AES module accelerator. Select this if you
	  want to use the P7 module for AES algorithms.
```

## sources/linux-unknown/linux-unknown/drivers/parrot/dma/Kconfig
```kconfig
config DMA_PARROT7
	bool "Parrot7 PL330 DMA controller workarounds"
    depends on PL330_DMA
	default ARCH_VEXPRESS_P7FPGA || ARCH_PARROT7
	help
      	Enable workarounds for Parrot7 only implementation of PL330 based DMA controller.
```

## sources/linux-unknown/linux-unknown/drivers/parrot/i2c/muxes/Kconfig
```kconfig
config I2C_MUX_PARROT7
       tristate "Parrot I2C master multiplexer"
       depends on I2C_MUX && I2CM_PARROT7
       help
         This driver will create I2C adapters to access multiple buses from the
         same master trough multiplexed pin configurations (e.g. I2C_2_CLKa,
         I2C_2_CLKb etc...).
```

## sources/linux-unknown/linux-unknown/drivers/parrot/iio/Kconfig
```kconfig
menu "IIO Parrot drivers"
        depends on IIO

source "drivers/parrot/iio/adc/Kconfig"
source "drivers/parrot/iio/imu/Kconfig"
source "drivers/parrot/iio/bldc/Kconfig"
source "drivers/parrot/iio/magnetometer/Kconfig"
source "drivers/parrot/iio/parrot/Kconfig"
source "drivers/parrot/iio/pressure/Kconfig"
if IIO_TRIGGER
source "drivers/parrot/iio/trigger/Kconfig"
endif # IIO_TRIGGER

endmenu
```

## sources/linux-unknown/linux-unknown/drivers/parrot/iio/bldc/Kconfig
```kconfig
#
# BLDC drivers
#

config IIO_PARROT_BLDC_CYPRESS
	tristate "PARROT BLDC CYPRESS IIO driver"
	depends on I2C && SYSFS
	select IIO_BUFFER
	select IIO_TRIGGERED_BUFFER
	help
	  Say yes here to build support for the BLDC cypress driver.

config IIO_PARROT_BLDC_CYPRESS_I2C
	tristate "PARROT BLDC CYPRESS IIO i2c driver"
	depends on I2C && SYSFS
	select IIO_PARROT_BLDC_CYPRESS
	select IIO_BUFFER
	select IIO_TRIGGERED_BUFFER
	help
	  Say yes here to build support for the BLDC cypress i2c driver.
```

## sources/linux-unknown/linux-unknown/drivers/parrot/iio/imu/Kconfig
```kconfig
#
# IIO imu drivers configuration
#
# When adding new entries keep the list in alphabetical order

menu "Inertial measurement units"

source "drivers/parrot/iio/imu/inv_mpu6050/Kconfig"

endmenu
```

## sources/linux-unknown/linux-unknown/drivers/parrot/iio/magnetometer/Kconfig
```kconfig
#
# Magnetometer sensors
#
# When adding new entries keep the list in alphabetical order

menu "Magnetometers"

config PARROT_IIO_AK8975
	tristate "Asahi Kasei AK8975 3-Axis Magnetometer"
	depends on I2C && SYSFS && GPIOLIB
	select IIO_BUFFER
	select IIO_TRIGGERED_BUFFER
	help
	  Say yes here to build support for Asahi Kasei AK8975 3-Axis
	  Magnetometer. This driver can also support AK8963, if i2c
	  device name is identified as ak8963.

	  To compile this driver as a module, choose M here: the module
	  will be called ak8975.


config PARROT_IIO_AK8975_TIMESTAMPS
	bool "AK8975: allow display of timestamps"
	depends on PARROT_IIO_AK8975
	default n

endmenu
```

## sources/linux-unknown/linux-unknown/drivers/parrot/iio/parrot/Kconfig
```kconfig
#
# Pressure drivers
#
# When adding new entries keep the list in alphabetical order

menu "Parrot sensors"

config PARROT_IIO_MYKONOS3
	tristate "Device that triggers BLDC, magnetometer & barometer"
	depends on I2C && SYSFS
	select IIO_BUFFER
	select IIO_TRIGGERED_BUFFER
	help

endmenu
```

## sources/linux-unknown/linux-unknown/drivers/parrot/iio/pressure/Kconfig
```kconfig
#
# Pressure drivers
#
# When adding new entries keep the list in alphabetical order

menu "Pressure sensors"

config PARROT_IIO_MS5607
	tristate "Measurement Specialties MS5607-02BA03 pressure sensor driver"
	depends on I2C && SYSFS
	select IIO_BUFFER
	select IIO_TRIGGERED_BUFFER
	help
	  Say yes here to build support for the Measurement Specialties MS5607
	  pressure sensor connected via I2C.

          To compile this driver as a module, choose M here: the module
          will be called ms5607.

config PARROT_IIO_MS5607_TIMESTAMPS
	bool "MS5607: allow display of timestamps"
	depends on PARROT_IIO_MS5607
	default n

endmenu
```

## sources/linux-unknown/linux-unknown/drivers/parrot/input/touchscreen/Kconfig
```kconfig
config TOUCHSCREEN_ATMEL_MXT
	tristate "Atmel mXT I2C Touchscreen"
	depends on I2C && INPUT_TOUCHSCREEN && TI_UB925_LVDS
	help
	  Say Y here if you have Atmel mXT series I2C touchscreen,
	  such as AT42QT602240/ATMXT224, connected to your system.

	  If unsure, say N.

	  To compile this driver as a module, choose M here: the
	  module will be called atmel_mxt_ts.

config TOUCHSCREEN_ANTEC
	tristate "Antec Touchscreen"
	depends on I2C && INPUT_TOUCHSCREEN && MACH_PARROT_ANTEC
	default m
	help
	  Say Y here if you have Antec touchscreen

	  To compile this driver as a module, choose M here: the
	  module will be called antec_ts.
```

## sources/linux-unknown/linux-unknown/drivers/parrot/media/video/Kconfig
```kconfig
config AVI_V4L2
	tristate "AVI V4L2 interface"
	depends on AVI
	depends on VIDEO_V4L2
	default n
	help
	  Build the AVI V4L2 interface layer.

config AVI_V4L2_DEV
       tristate "AVI V4L2 device interface"
       depends on AVI_V4L2
       default n
       help
         Build the AVI V4L2 device interface

config AVI_V4L2_ISP
	tristate "AVI V4L2 ISP interface"
	depends on AVI_V4L2
	default n
	help
	  Build the AVI V4L2 ISP interface

config AVI_V4L2_GST_COLORSPACE_HACK
	bool "Hack for Gstreamer colorspace bad handling"
	default y
	depends on AVI_V4L2
	help
	  gstreamer v4l2sink and src do not handle the colorspace
	  correctly, they set bad values in the pix structure
	  (actually, they don't set anything, they use whatever they
	  get in g_fmt). Since we cannot trust the value we try
	  to guess the colorspace

config CAM_AVI
	tristate "Parrot Advanced Video Interface camif support"
	depends on AVI_V4L2
	select VIDEOBUF2_DMA_CONTIG
	select CAM_AVI_DUMMY
	help
	  Support for the camera interface in the Parrot AVI IP

config AVICAM_TIMINGS_AUTO
	bool "Automatic timings detection on avicam input"
	depends on CAM_AVI
	default n
	help
	  This option enables the automatic detection of timings on
	  avicam input instead of getting format from v4l2-subdev

config AVICAM_INSTANT_STREAMOFF
	bool "Force avicam streamoff to be instantaneous"
	depends on CAM_AVI
	default n
	help
	  This option will not wait for remaining frames during streamoff
	  and instead will force the AVI to shutdown instantaneously.
	  It is useful for low-framerate modes.

config AVICAM_USE_ISP
	bool "Enable ISP V4L2 controls in avicam interface"
	depends on CAM_AVI && AVI_V4L2_ISP
	default n
	help
	  This option add many controls to V4L2 interface in order to control
	  internal ISP chain of Parrot7.

config CAM_AVI_DUMMY
	tristate "Parrot AVI dummy cam driver"
	depends on AVI && CAM_AVI
	help
	  Support for the dummy avi cam driver

config AVI_CAPTURE_TEST
	tristate "Parrot Advanced Video Interface capture test driver"
	depends on CAM_AVI
	default n
	help
	  Support for capture

config AVI_MULTICAPTURE
	tristate "Parrot Advanced Video Interface Multiple capture"
	depends on CAM_AVI
	default n
	help
	  Support for multiple captures

config VIDOUT_AVI
	tristate "Parrot Advanced Video Interface video output overlays support"
	depends on AVI_V4L2
	select VIDEOBUF2_DMA_CONTIG
	default n
	help
	  Enable support for AVI video output overlays.

	  You can turn debug traces on/off with module option debug=0
	  or debug=1.
	  You can turn off dual channel usage for semi-planar with
	  monochannel=1 (test purpose)

config R2R_AVI
	tristate "Parrot Advanced Video Interface RAM to RAM support"
	depends on AVI
	help
	  Enable support for AVI RAM to RAM.

config M2M_AVI
	tristate "V4L2 MEM2MEM interface"
	depends on AVI_V4L2
	select VIDEOBUF2_DMA_CONTIG
	select V4L2_MEM2MEM_DEV
	help
	  V4L2 MEM2MEM interface

config M2M_AVI_USE_ISP
	bool "Enable ISP V4L2 controls in MEM2MEM interface"
	depends on M2M_AVI && AVI_V4L2_ISP
	default n
	help
	  This option add many controls to V4L2 interface in order to control
	  internal ISP chain of Parrot7.

config R2R_AVI_TEST_MULTI
	tristate "Test module for AVI RAM to RAM with multiple clients support"
	depends on R2R_AVI && AVI_DEBUG && DEBUG_FS
	default n
	help
	  Test module for AVI RAM to RAM with multiple clients support.

config R2R_AVI_TEST_MULTI_NUMBER
	int "Number of clients"
	depends on R2R_AVI_TEST_MULTI
	default 3
	help
	  Number of clients: minimum 1, maximum 6, default 3

config R2R_AVI_TEST_MULTI_RESMEM
	int "Size of reserved memory per client (MegaBytes)"
	depends on R2R_AVI_TEST_MULTI
	default 64
	help
	  Size of reserved memory per client in MegaBytes, default 64 MB.

config CAM_LEPTON
	tristate "Lepton camera support"
	depends on SPI_MASTER && I2C
	select VIDEOBUF2_DMA_CONTIG
	default n
	help
	  This enables the Lepton camera driver
```
