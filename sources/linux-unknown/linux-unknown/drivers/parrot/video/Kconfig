## sources/linux-unknown/linux-unknown/drivers/parrot/video/Kconfig
```kconfig
menuconfig AVI
	tristate "Parrot Advanced Video Interface support"
	default n

config AVI_DEBUG
	bool "Compile AVI for debugging purposes"
	depends on AVI
	default n
	help
	  Enable this if you want AVI drivers with debug info

config AVI_DEBUG_LOG
	bool "Enable debug log"
	depends on AVI_DEBUG
	default n
	help
	  Enable this if you want AVI drivers to output debug messages and perform
	  additionnal consistency checks.

config AVI_DEBUGFS
	tristate "Enable debugging info via debugfs"
	depends on AVI_DEBUG && DEBUG_FS
	depends on AVI
	help
	  Enable this if you want debugging information using the debug
	  filesystem (debugfs)

config AVI_LOGGER
        bool "Log all AVI register access in debugfs"
	depends on AVI_DEBUGFS
	default n
	help
	  Enable this if you want to have access to a circular buffer holding
	  all register access (R/W) through the debugfs.

config FB_AVI
	tristate "Parrot Advanced Video Interface framebuffer support"
	depends on FB && AVI
	select FB_CFB_FILLRECT
	select FB_CFB_COPYAREA
	select FB_CFB_IMAGEBLIT
	help
	  Enable support for AVI framebuffer.

config FB_AVI_PAN_WAITS_FOR_VSYNC
	bool "Make AVI framebuffer PAN operations wait for VBL by default"
	depends on FB_AVI
	default y
	help
	  Some userland applications expect the FBIOPAN_DISPLAY ioctl to block
	  until the PAN operation is effective, i.e. at the next VBL. This
	  options sets the default, it is configurable at runtime via sysfs.

config VSYNC_GEN_AVI
       tristate "Parrot Advanced Video Interface vsync generator support"
       depends on AVI
       help
         Enable support for the AVI vsync generator used to synchronize slave
         cameras.
```

## sources/linux-unknown/linux-unknown/drivers/pwm/Kconfig
```kconfig
menuconfig PWM
	bool "Pulse-Width Modulation (PWM) Support"
	depends on !MACH_JZ4740 && !PUV3_PWM
	help
	  Generic Pulse-Width Modulation (PWM) support.

	  In Pulse-Width Modulation, a variation of the width of pulses
	  in a rectangular pulse signal is used as a means to alter the
	  average power of the signal. Applications include efficient
	  power delivery and voltage regulation. In computer systems,
	  PWMs are commonly used to control fans or the brightness of
	  display backlights.

	  This framework provides a generic interface to PWM devices
	  within the Linux kernel. On the driver side it provides an API
	  to register and unregister a PWM chip, an abstraction of a PWM
	  controller, that supports one or more PWM devices. Client
	  drivers can request PWM devices and use the generic framework
	  to configure as well as enable and disable them.

	  This generic framework replaces the legacy PWM framework which
	  allows only a single driver implementing the required API. Not
	  all legacy implementations have been ported to the framework
	  yet. The framework provides an API that is backward compatible
	  with the legacy framework so that existing client drivers
	  continue to work as expected.

	  If unsure, say no.

config PWM_SYSFS
	bool "Pulse-Width Modulation (PWM) SYSFS Support"
	depends on PWM
	default no
	help
	  Add SYSFS support to PWM framework

config PWM_SYSFS_DEBUG
	bool "Pulse-Width Modulation (PWM) SYSFS Support Debug"
	depends on PWM_SYSFS
	default no
	help
	  Activate DEBUG for SYSFS 
```
