## sources/linux-3.4.11/linux-3.4.11/drivers/parrot/pwm/Kconfig
```kconfig
config PWM_P7MU
	tristate "Parrot P7MU PWM"
	depends on PWM && MFD_P7MU
	select HAVE_PWM
	default m
	help
	  Builds the Parrot7 power Management Unit PWM blocks driver.

config PWM_P7MU_DEBUG
	bool "Debug P7MU PWM"
	depends on PWM_P7MU
	default no
	help
	  Build Parrot7 power Management Unit PWM blocks driver with debug enabled

config PWM_PARROT7
	tristate "Parrot7 PWM driver (Pulse Width Modulation)"
	depends on PWM
	select HAVE_PWM
	default m
	help
	  Enables support for Parrot7 PWM driver

config PWM_PARROT7_DEBUG
	bool "Debug PARROT7 PWM"
	depends on PWM_PARROT7
	default no
	help
	  Build Parrot7 PWM block driver with debug enabled
```

## sources/linux-3.4.11/linux-3.4.11/drivers/parrot/regulator/Kconfig
```kconfig
config REGULATOR_SWITCH_VOLTAGE
   bool "Switch voltage regulator"
   depends on REGULATOR
   default MMC_SDHCI_ACS3 if ARCH_PARROT7
   help
     Switch voltage regulator based on GPIO regulator.
```

## sources/linux-3.4.11/linux-3.4.11/drivers/parrot/serial/Kconfig
```kconfig
config SERIAL_PARROTX
	bool "Parrot5/5+/6/6i/7 serial port support"
	depends on ARCH_PARROT7
	select SERIAL_CORE
	help
	  If you have a board based on Parrot5/5+/6/6i/7 SoC you
	  can enable its onboard serial port by enabling this option.

	  To compile this driver as a module, choose M here: the
	  module will be called px-serial.

config SERIAL_PARROTX_CONSOLE
	bool "Console on Parrot5/5+ serial port"
	depends on SERIAL_PARROTX
	select SERIAL_CORE_CONSOLE
	help
	  Select this option if you want to use one of the Parrot5/5+/6/6i/7 serial ports
	  as console.

config SERIAL_ZPRINT
	bool "ZPrint transactor support"
	depends on MACH_PARROT_ZEBU
	default y
	help
	  Enable support for ZPrint transactor output.
```

## sources/linux-3.4.11/linux-3.4.11/drivers/parrot/spi/Kconfig
```kconfig
config SPI_PARROT7
	tristate "Parrot7 SPI kernel driver"
	depends on SPI
	default n
	default m if (ARCH_PARROT7 || ARCH_VEXPRESS_P7FPGA)
	help
	  Select Parrot7 SPI hardware driver.

config SPI_MASTER_PARROT7
	tristate "Parrot7 SPI master driver"
	depends on SPI_MASTER && SPI_PARROT7
	default m
	help
	  Select Parrot7 SPI master driver.

config SPI_MASTER_PARROT7_TEST
	tristate "Parrot7 SPI master test"
	depends on SPI_MASTER_PARROT7
	default n
	help
	  Test module, sends or receives some data on a master spi.

config SPI_MASTER_PARROT7_LOOPBACK_TEST
	tristate "Enable loopback test module"
	depends on SPI_MASTER_PARROT7
	default n
	help
	  Test module to test SPI slave using the loopback.

config SPI_MASTER_SPARTAN6
	tristate "Parrot7 SPI Spartan6 FPGA"
	depends on SPI_MASTER_PARROT7
	select SPI_SPIDEV
	default n
	help
	 Enables spidev's interface to Spartan6 FPGA.

config SPI_SLAVE_PARROT7
	tristate "Parrot7 SPI slave driver"
	depends on SPI_MASTER && SPI_PARROT7
	default m
	help
	Select Parrot7 SPI slave driver. Requires the master driver to be 
	selected to handle common registers.

config SPI_SLAVE_PARROT7_LOOPBACK_TEST
	tristate "Enable loopback test module"
	depends on SPI_SLAVE_PARROT7
	default n
	help
	  Test module to test SPI slave using the loopback.
```
