## sources/linux-3.4.11/linux-3.4.11/drivers/iio/trigger/Kconfig
```kconfig
#
# Industrial I/O standalone triggers
#
# When adding new entries keep the list in alphabetical order

menu "Triggers - standalone"

config IIO_INTERRUPT_TRIGGER
	tristate "Generic interrupt trigger"
	help
	  Provides support for using an interrupt of any type as an IIO
	  trigger.  This may be provided by a gpio driver for example.

	  To compile this driver as a module, choose M here: the
	  module will be called iio-trig-interrupt.

config IIO_HRTIMER_TRIGGER
	tristate "Generic hrtimer trigger"
	depends on SYSFS
	select HIGH_RES_TIMERS
	help
	  Provides support for using a high resolution timer as an IIO
	  trigger.

	  To compile this driver as a module, choose M here: the
	  module will be called iio-trig-hrtimer.

config IIO_SYSFS_TRIGGER
	tristate "SYSFS trigger"
	depends on SYSFS
	select IRQ_WORK
	help
	  Provides support for using SYSFS entries as IIO triggers.
	  If unsure, say N (but it's safe to say "Y").

	  To compile this driver as a module, choose M here: the
	  module will be called iio-trig-sysfs.

config IIO_TIGHTLOOP_TRIGGER
	tristate "A kthread based hammering loop trigger"
	help
	  A horrible bodge as an experiment.

endmenu
```

## sources/linux-3.4.11/linux-3.4.11/drivers/parrot/Kconfig
```kconfig
menu "Parrot drivers"
source "drivers/parrot/serial/Kconfig"
source "drivers/parrot/block/Kconfig"
source "drivers/parrot/nand/Kconfig"
source "drivers/parrot/i2c/Kconfig"
source "drivers/parrot/video/Kconfig"
source "drivers/parrot/media/Kconfig"
source "drivers/parrot/uio/Kconfig"
source "drivers/parrot/gpu/Kconfig"
source "drivers/parrot/dma/Kconfig"
source "drivers/parrot/net/Kconfig"
source "drivers/parrot/mmc/Kconfig"
source "drivers/parrot/regulator/Kconfig"
source "drivers/parrot/mfd/Kconfig"
source "drivers/parrot/rtc/Kconfig"
source "drivers/parrot/gpio/Kconfig"
source "drivers/parrot/pwm/Kconfig"
source "drivers/parrot/spi/Kconfig"
source "drivers/parrot/sound/p7_aai/Kconfig"
source "drivers/parrot/pinctrl/Kconfig"
source "drivers/parrot/usb/serial/blackberry/Kconfig"
source "drivers/parrot/input/Kconfig"
source "drivers/parrot/input/touchscreen/Kconfig"
source "drivers/parrot/gator/Kconfig"
source "drivers/parrot/iio/Kconfig"
source "drivers/parrot/crypto/Kconfig"
source "drivers/parrot/power/Kconfig"
source "drivers/parrot/lttng/Kconfig"
source "drivers/parrot/cpufreq/Kconfig"
endmenu
```

## sources/linux-3.4.11/linux-3.4.11/drivers/parrot/block/Kconfig
```kconfig
config BLK_DEV_PHYBRD
	tristate "RAM block device support for physically independant ram block"
	depends on BLOCK
	default MACH_PARROT_ZEBU
	help
	  This driver is for Parrot7 Zebu emulation environment. It helps to set up
	  a file system on a physically independant ram block which allows modification
	  of file system (ddr partial dump -> file system mount and modification 
	  on host machine -> ddr reinsertion -> execution resumes) without needing to
	  restart the linux boot sequence. This will accelerate the linux debugging
	  process under Zebu environment.
```

## sources/linux-3.4.11/linux-3.4.11/drivers/parrot/gpio/Kconfig
```kconfig
config GPIO_P7MU
	tristate "Parrot P7MU GPIO"
	depends on GPIOLIB && MFD_P7MU
	default m
	help
	  Builds the Parrot7 power Management Unit GPIO block driver.

config GPIO_P7MU_BUILTIN
	bool
	select GPIO_P7MU

config GPIO_HAVE_PARROT7
	bool
	depends on GPIOLIB && ARCH_PARROT7
	default y
	help
	  Builds the Parrot7 GPIO controller driver.

config GPIO_PARROT7
	bool "Parrot7 GPIO controller"
```

## sources/linux-3.4.11/linux-3.4.11/drivers/parrot/gpu/Kconfig
```kconfig
menu "Parrot7 GPU"

config GPU_PARROT7
	tristate "Parrot7 GPU support"
	default n
	---help---
        This will just enable support for Mali 200 GPU. 
        It requires Mali-200 of Mali-400 ARM drivers to be enabled.

config UMP_PARROT7
	tristate "Parrot7 UMP interface"
	depends on UMP
	default n
	---help---
        Driver to allow memory sharing between APIs by tracking UMP memory tokens.
	Used with Mali200 GPU. 

config UMP_PARROT7_AUTOLOAD
	bool "Enable Parrot7 UMP interface mapping autoload"
	depends on UMP_PARROT7
	default n
	---help---
	      Allow the Parrot7 UMP interface to automatically create a mapping when trying to access a non-existent one.

comment "ARM UMP memory sharing driver"
source "drivers/parrot/gpu/ump/Kconfig"

comment "ARM Mali200 driver"
source "drivers/parrot/gpu/mali200/Kconfig"

comment "ARM Mali400 driver"
source "drivers/parrot/gpu/mali400/Kconfig"

endmenu

source "drivers/parrot/gpu/ion/Kconfig"
```

## sources/linux-3.4.11/linux-3.4.11/drivers/parrot/gpu/ion/Kconfig
```kconfig
config ION_PARROT7
	bool "Parrot7 ION allocator"
	depends on ION && ARCH_PARROT7
	default ION
	help
	  Enable support for Parrot7 ION allocator.
```

## sources/linux-3.4.11/linux-3.4.11/drivers/parrot/gpu/mali200/Kconfig
```kconfig
config MALI200
	tristate "Mali-200 support"
	depends on ARM && !MALI400
	depends on GPU_PARROT7
	select FB
	---help---
	  This enables support for the Mali-200 GPUs.

	  To compile this driver as a module, choose M here: the module will be
	  called mali.

config MALI200_DEBUG
	bool "Enable debug in Mali driver"
	depends on MALI200
	---help---
	  This enabled extra debug checks and messages in the Mali-200
	  driver.

config MALI200_PROFILING
	bool "Enable Mali200 profiling"
	depends on MALI200 && TRACEPOINTS
	---help---
	  This enables gator profiling of Mali GPU events.

config MALI200_GPU_UTILIZATION
	bool "Enable Mali GPU utilization tracking"
	depends on MALI200
	---help---
	  This enables gathering and processing of the utilization of Mali GPU.
	  This data can be used as a basis to change GPU operating frequency.
```

## sources/linux-3.4.11/linux-3.4.11/drivers/parrot/gpu/mali400/Kconfig
```kconfig
config MALI400
	tristate "Mali-300/400/450 support"
	depends on ARM
	depends on GPU_PARROT7
	select DMA_SHARED_BUFFER
	select MALI400_SUPPORT
	---help---
	  This enables support for the ARM Mali-300, Mali-400, and Mali-450
	  GPUs.

	  To compile this driver as a module, choose M here: the module will be
	  called mali.

config MALI400_LEGACY
	bool "Legacy driver for mali400"
	depends on MALI400
	---help---
	  This enables the use of an older version of the mali driver
	  to be compatible with android 2.3

config MALI400_SUPPORT
	bool "Support for mali 400"
	depends on MALI400

config MALI450
	bool "Enable Mali-450 support"
	depends on MALI400
	---help---
	  This enables support for Mali-450 specific features.

config MALI400_DEBUG
	bool "Enable debug in Mali driver"
	depends on MALI400
	---help---
	  This enabled extra debug checks and messages in the Mali driver.

config MALI400_PROFILING
	bool "Enable Mali profiling"
	depends on MALI400
	select TRACEPOINTS
	default y
	---help---
	  This enables gator profiling of Mali GPU events.

config MALI400_INTERNAL_PROFILING
	bool "Enable internal Mali profiling API"
	depends on MALI400_PROFILING
	default n
	---help---
	  This enables the internal legacy Mali profiling API.

config MALI400_UMP
	bool "Enable UMP support"
	depends on MALI400
	---help---
	  This enables support for the UMP memory sharing API in the Mali driver.

config MALI400_POWER_PERFORMANCE_POLICY
	bool "Enable Mali power performance policy"
	depends on ARM
	default n
	---help---
	  This enables support for dynamic performance scaling of Mali with the goal of lowering power consumption.

config MALI400_RT_WORKER
	bool "Enable real-time worker in Mali driver"
	depends on MALI400
	---help---
	  This allow to configure real-time priority for Mali worker thread and avoid to be locked by others real-time threads.

config MALI400_RT_WORKER_PRIORITY
	int "Real-time priority for Mali 400 worker"
	depends on MALI400_RT_WORKER
	default 1
	range 1 99
	---help---
	  This parameter defines the real-time property for the worker used for
	  async task in the Mali driver.
	  This priority will be used as a SCHED_FIFO priority, 1 the lowest priority
	  and 99 as the highest prority.

config MALI_DMA_BUF_MAP_ON_ATTACH
	bool "Map dma-buf attachments on attach"
	depends on MALI400 && DMA_SHARED_BUFFER
	default y
	---help---
	  This makes the Mali driver map dma-buf attachments after doing
	  attach. If this is not set the dma-buf attachments will be mapped for
	  every time the GPU need to access the buffer.

	  Mapping for each access can cause lower performance.

config MALI_SHARED_INTERRUPTS
	bool "Support for shared interrupts"
	depends on MALI400
	default n
	---help---
	  Adds functionality required to properly support shared interrupts.  Without this support,
	  the device driver will fail during insmod if it detects shared interrupts.  This also
	  works when the GPU is not using shared interrupts, but might have a slight performance
	  impact.

config MALI_PMU_PARALLEL_POWER_UP
	bool "Power up Mali PMU domains in parallel"
	depends on MALI400
	default n
	---help---
	  This makes the Mali driver power up all PMU power domains in parallel, instead of
	  powering up domains one by one, with a slight delay in between. Powering on all power
	  domains at the same time may cause peak currents higher than what some systems can handle.
	  These systems must not enable this option.
```

## sources/linux-3.4.11/linux-3.4.11/drivers/parrot/i2c/Kconfig
```kconfig
config I2CM_PARROT7
	tristate "Parrot7 I2C master driver"
	depends on I2C
	default n
	default m if (ARCH_VEXPRESS_P7FPGA)
	help
	Select Parrot7 I2C master driver.

config I2CM_PARROT7_BUILTIN
	bool
	select I2CM_PARROT7

config I2CM_PARROT7_DEBUG
	bool "Parrot I2C master driver debug"
	depends on I2CM_PARROT7
	default n
	help
	Add debug informations, only available on legacy driver at the moment

config I2CM_PARROT7_DEBUGFS
	bool "Parrot I2C master debugfs interface"
	depends on (I2CM_PARROT7 && DEBUG_FS)
	default n
	help
	Creates a debugfs interface for easily changing the I2C bus speed.

config PLDS_I2CS
       tristate "I2CS PLDS block layer driver"
       default n
       help
         I2CS PLDS block layer driver for DVD player, can be used with 
         /dev/plds peripheral

config TI_UB925_LVDS
	bool "TI DS90UB925Q LVDS Serializer support"
	depends on I2C
	default n
	help
	Enable support for TI DS90UB925Q LVDS serialized, including I2C and
	interrupt pass through.


config PARROT_SMSC_USB82514_USB_HUB
	bool "SMSC USB82514 USB HUB"
	depends on I2C
	help
		Automotive Grade USB 2.0 Hi-Speed 4-Port Hub

source "drivers/parrot/i2c/muxes/Kconfig"
```

## sources/linux-3.4.11/linux-3.4.11/drivers/parrot/iio/adc/Kconfig
```kconfig
#
# ADC drivers
#
menu "Analog to Digital converters"

config P7MU_ADC
	tristate "P7MU ADC driver"
	depends on SPI
	depends on SPI_SLAVE_PARROT7
	depends on MFD_P7MU
	select P7_ADC
        select P7MU_ADC_RING_BUFFER
	help
	  Say yes here to build support for the P7MU
	  SPI/I2C analog to digital converter (ADC).

config P7MU_ADC_RING_BUFFER
	bool "Analog Devices P7MUADC: use buffer"
	depends on P7MU_ADC
	select IIO_BUFFER
	select IIO_KFIFO_BUF
	help
	  Say yes here to include ring buffer support in the P7MUADC driver.

config P7MU_ADC_DEBUG
	bool "P7 ADC debug"
	depends on P7MU_ADC
	help
	  Say yes here if you have trouble with the P7 ADC driver and want to
	  debug it.

config P7_TEMPERATURE
	tristate "P7 temperature driver"
	select P7MU_ADC
	help
	  Say yes here to build support for the thermal sensor.

config P7_TEMPERATURE_FC7100
	tristate "P7 FC7100 temperature driver"
	select P7_ADC
	help
	  Say yes here to build support for the thermal sensor.

config P7_ADC
	bool "P7 ADC driver"
	depends on (P7_TEMPERATURE || P7_TEMPERATURE_FC7100 || P7MU_ADC)
	help
	  Say yes here to build support for the P7
	  analog to digital converter (ADC).


endmenu
```

## sources/linux-3.4.11/linux-3.4.11/drivers/parrot/iio/bldc/Kconfig
```kconfig
#
# BLDC drivers
#

menu "BLDC"

config IIO_PARROT_BLDC_CYPRESS
	tristate "PARROT BLDC CYPRESS IIO driver"
	depends on I2C && SYSFS
	select IIO_BUFFER
	select IIO_TRIGGERED_BUFFER
	help
	  Say yes here to build support for the BLDC cypress driver.

config IIO_PARROT_BLDC_CYPRESS_I2C
	tristate "PARROT BLDC CYPRESS IIO i2c driver"
	depends on I2C && SYSFS
	select IIO_PARROT_BLDC_CYPRESS
	select IIO_BUFFER
	select IIO_TRIGGERED_BUFFER
	help
	  Say yes here to build support for the BLDC cypress i2c driver.

config PARROT_BLDC_CYPRESS_NOTRIGGER
	bool "BLDC Cypress: synchronous i2c acces with mykonos3 iio device"
	depends on IIO_PARROT_BLDC_CYPRESS
	select PARROT_IIO_MYKONOS3
	default n

endmenu
```

## sources/linux-3.4.11/linux-3.4.11/drivers/parrot/iio/magnetometer/Kconfig
```kconfig
#
# Magnetometer sensors
#
# When adding new entries keep the list in alphabetical order

menu "Magnetometers"

config PARROT_IIO_AK8975
	tristate "Asahi Kasei AK8975 3-Axis Magnetometer"
	depends on I2C && SYSFS && GPIOLIB && !AK8975
	select IIO_BUFFER
	select IIO_TRIGGERED_BUFFER
	help
	  Say yes here to build support for Asahi Kasei AK8975 3-Axis
	  Magnetometer. This driver can also support AK8963, if i2c
	  device name is identified as ak8963.

	  To compile this driver as a module, choose M here: the module
	  will be called ak8975.


config PARROT_IIO_AK8975_TIMESTAMPS
	bool "AK8975: allow display of timestamps"
	depends on PARROT_IIO_AK8975
	default n

config PARROT_AK8963_NOTRIGGER
	bool "AK8975: synchronous i2c acces with mykonos3 iio device"
	depends on PARROT_IIO_AK8975
	select PARROT_IIO_MYKONOS3
	default n

endmenu
```

## sources/linux-3.4.11/linux-3.4.11/drivers/parrot/iio/pressure/Kconfig
```kconfig
#
# Pressure drivers
#
# When adding new entries keep the list in alphabetical order

menu "Pressure sensors"

config PARROT_IIO_MS5607
	tristate "Measurement Specialties MS5607-02BA03 pressure sensor driver"
	depends on I2C && SYSFS
	select IIO_BUFFER
	select IIO_TRIGGERED_BUFFER
	help
	  Say yes here to build support for the Measurement Specialties MS5607
	  pressure sensor connected via I2C.

          To compile this driver as a module, choose M here: the module
          will be called ms5607.

config PARROT_IIO_MS5607_TIMESTAMPS
	bool "MS5607: allow display of timestamps"
	depends on PARROT_IIO_MS5607
	default n

config PARROT_MS5607_NOTRIGGER
	bool "MS5607: synchronous i2c acces with mykonos3 iio device"
	depends on PARROT_IIO_MS5607
	select PARROT_IIO_MYKONOS3
	default n

endmenu
```

## sources/linux-3.4.11/linux-3.4.11/drivers/parrot/iio/trigger/Kconfig
```kconfig
#
# Industrial I/O standalone triggers
#
# When adding new entries keep the list in alphabetical order

menu "Triggers - standalone"

config PARROT_IIO_HRTIMER_TRIGGER
	tristate "Generic hrtimer trigger"
	depends on SYSFS
	select HIGH_RES_TIMERS
	help
	  Provides support for using a high resolution timer as an IIO
	  trigger.

	  To compile this driver as a module, choose M here: the
	  module will be called iio-trig-hrtimer.

endmenu
```

## sources/linux-3.4.11/linux-3.4.11/drivers/parrot/media/Kconfig
```kconfig
source "drivers/parrot/media/video/Kconfig"

config MPEGTS_PARROT7
	tristate "MPEG_TS driver"
	depends on SPI_MASTER && SPI_PARROT7
	default m
	help
	  Select Parrot7 MPEG_TS driver. Requires the SPI master driver to be
	  selected to handle common registers.

config MPEGTS_PARROT7_DEBUG
	bool "debug mode"
	depends on MPEGTS_PARROT7
	default n
```

## sources/linux-3.4.11/linux-3.4.11/drivers/parrot/nand/Kconfig
```kconfig
config MTD_NAND_CAST
	tristate "Support for CAST NAND Controller"
	depends on MTD_NAND
	default MTD_NAND if ARCH_PARROT7
	help
	  Enables support for CAST NAND Controller with hardware ECC module.
```

## sources/linux-3.4.11/linux-3.4.11/drivers/parrot/net/Kconfig
```kconfig
config KSZ8851SNL
    tristate "KSZ8851SNL Ethernet support"
	depends on ARM && SPI && ETHERNET
	help
	  If you have a KSZ8851SNL Ethernet chip on your board say Y.
	  Otherwise, say N.

	  To compile this driver as a module, choose M here: the module
	  will be called ksz8851snl.
```
